#include "sofle.dtsi" // The shared dtsi file is included in the overlay

// Label of the kscan node in the dtsi
&kscan0 {
    col-gpios
        = <&nice_nano 10 GPIO_ACTIVE_HIGH>
        , <&nice_nano 11 GPIO_ACTIVE_HIGH>
        , <&nice_nano 13 GPIO_ACTIVE_HIGH>
        ;
};

&default_transform { // Offset of 3 because the left side has 3 columns
    col-offset = <7>;
};