#include "sofle.dtsi" // The shared dtsi file is included in the overlay

// Label of the kscan node in the dtsi
&kscan0 {
    col-gpios
        = <&nice_nano 0 GPIO_ACTIVE_HIGH>
        , <&nice_nano 4 GPIO_ACTIVE_HIGH>
        , <&nice_nano 5 GPIO_ACTIVE_HIGH>
        , <&nice_nano 6 GPIO_ACTIVE_HIGH>
        , <&nice_nano 7 GPIO_ACTIVE_HIGH>
        , <&nice_nano 8 GPIO_ACTIVE_HIGH>
        , <&nice_nano 9 GPIO_ACTIVE_HIGH>
        ;
};